## drivers/input/touchscreen/hynitron/Kconfig
```kconfig
config TOUCHSCREEN_HYNITRON_TS
	bool "hynitron Ts for TOUCHSCREEN"
	depends on I2C
	depends on INPUT
	default y
	help
	  Say Y here if you have hynitron touch panel.
	  If unsure, say N.
```
